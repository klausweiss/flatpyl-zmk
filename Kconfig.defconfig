## Kconfig.defconfig
```kconfig
if SHIELD_FLATPYL_LEFT

config ZMK_KEYBOARD_NAME
    default "Flatpyl Keyboard"

config ZMK_SPLIT_ROLE_CENTRAL
    default y

endif


if SHIELD_FLATPYL_LEFT || SHIELD_FLATPYL_RIGHT

config ZMK_SPLIT
    default y

endif
```

## boards/shields/flatpyl/Kconfig.defconfig
```kconfig
if SHIELD_FLATPYL_LEFT

config ZMK_KEYBOARD_NAME
    default "flatpyl kb"

config ZMK_SPLIT_ROLE_CENTRAL
    default y

endif


if SHIELD_FLATPYL_LEFT || SHIELD_FLATPYL_RIGHT

config ZMK_SPLIT
    default y

endif
```

## boards/shields/flatpyl/Kconfig.shield
```kconfig
config SHIELD_FLATPYL_LEFT
    def_bool $(shields_list_contains,flatpyl_left)

config SHIELD_FLATPYL_RIGHT
    def_bool $(shields_list_contains,flatpyl_right)
```
